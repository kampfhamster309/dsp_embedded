## components/dsp_config/Kconfig
```kconfig
menu "DSP Embedded Configuration"

    config DSP_ENABLE_PSK
        bool "Enable Pre-Shared Key (PSK) authentication module"
        default n
        help
            Enables the dsp_psk component, which stores a PSK identity and
            key pair and applies it to mbedTLS TLS connections. Use in
            highly constrained environments where X.509 certificates are
            not available. PSK is stored in NVS and applied via
            dsp_psk_apply(). When disabled, no PSK symbols are compiled in.

    config DSP_ENABLE_CATALOG_REQUEST
        bool "Enable dynamic catalog request endpoint (POST /catalog/request)"
        default n
        help
            Enables the POST /catalog/request endpoint (DSP priority: SHOULD).
            Allows counterparts to query the catalog with filter parameters
            instead of always receiving the full static catalog.
            Adds ~2 KB RAM overhead. Disable to save memory on highly
            constrained builds.

    config DSP_ENABLE_CONSUMER
        bool "Enable consumer role (node can request data from others)"
        default n
        help
            Activates consumer-side DSP endpoints so the node can initiate
            contract negotiations and data transfers toward other connectors.
            Not included in the initial provider-only release scope.
            Adds significant code and RAM overhead — only enable if the
            application requires the node to pull data from remote peers.

    config DSP_ENABLE_DAPS_SHIM
        bool "Enable DAPS gateway compatibility shim"
        default n
        help
            Enables a forwarding shim that proxies identity token requests
            to a configured external DAPS/OAuth2 gateway. Use this when the
            counterpart requires full DAPS-issued tokens and a gateway is
            available in the deployment.
            Requires DSP_DAPS_GATEWAY_URL to be set.

    config DSP_DAPS_GATEWAY_URL
        string "DAPS gateway URL"
        default ""
        depends on DSP_ENABLE_DAPS_SHIM
        help
            Base URL of the DAPS gateway to proxy token requests to.
            Example: https://daps.example.org
            Only used when DSP_ENABLE_DAPS_SHIM is enabled.

    config DSP_TLS_SESSION_TICKETS
        bool "Enable TLS session ticket resumption"
        default y
        help
            Enables TLS 1.3 session tickets to reduce handshake overhead
            on reconnection. Particularly valuable for battery-powered nodes
            that disconnect between transfers. Requires mbedTLS session ticket
            support (CONFIG_MBEDTLS_SSL_SESSION_TICKETS).
            Disable only if the counterpart does not support session tickets.

    config DSP_PSRAM_ENABLE
        bool "Enable external PSRAM for larger buffers"
        default n
        help
            Allocates large buffers (TLS I/O, HTTP body, JSON payloads) in
            external PSRAM instead of internal SRAM. Requires an ESP32-S3
            module with 8 MB PSRAM populated and CONFIG_SPIRAM enabled.
            Without PSRAM the total DSP Embedded footprint must stay ≤130 KB
            internal RAM; with PSRAM this constraint is relaxed for heap
            allocations.

    config DSP_DEEP_SLEEP_BETWEEN_TX
        bool "Enter deep sleep between data transfers"
        default n
        help
            Enables the power management logic that puts the node into deep
            sleep after completing a transfer and wakes it on a timer or
            external interrupt for the next cycle. State (catalog, active
            negotiations) is preserved in RTC memory across sleep cycles.
            Reduces average current from ~120 mA to ~20 µA during idle.
            Disable for always-on deployments or during development/debugging.

    config DSP_ENABLE_NEGOTIATE_TERMINATE
        bool "Enable negotiation termination endpoint (POST /negotiations/terminate)"
        default n
        help
            Enables the POST /negotiations/terminate endpoint (DSP priority:
            MAY). Allows either party to abort an in-progress negotiation.
            Adds minimal overhead but is not required for basic provider
            operation.

    config DSP_MAX_CONCURRENT_NEGOTIATIONS
        int "Maximum concurrent negotiations"
        default 4
        range 1 16
        help
            Maximum number of contract negotiations the node tracks
            simultaneously. Each negotiation consumes approximately 256 bytes
            of RAM from the DSP state machine budget. Reduce to 1 on very
            tight builds; increase only if PSRAM is available.

    config DSP_MAX_CONCURRENT_TRANSFERS
        int "Maximum concurrent transfers"
        default 2
        range 1 8
        help
            Maximum number of simultaneous active transfers. Each transfer
            context consumes approximately 512 bytes. The default of 2 is
            appropriate for most sensor node deployments.

    config DSP_HTTP_PORT
        int "HTTP server port"
        default 80
        range 1 65535
        help
            TCP port the DSP HTTP/1.1 server listens on. Use 443 when TLS
            is enforced end-to-end. Port 80 is acceptable in deployments
            where TLS termination is handled by a reverse proxy.

    config DSP_WIFI_MAX_RETRY
        int "Maximum WiFi reconnect attempts before giving up"
        default 5
        range 1 20
        help
            Number of times dsp_wifi will attempt to (re)connect before
            transitioning to DSP_WIFI_STATE_FAILED and emitting
            DSP_WIFI_EVT_FAILED. Set to a higher value for deployments
            with intermittent connectivity.

    config DSP_WIFI_RECONNECT_DELAY_MS
        int "Delay between WiFi reconnect attempts (milliseconds)"
        default 1000
        range 100 30000
        help
            Time dsp_wifi waits after a disconnect before attempting to
            reconnect. Increase for battery-powered nodes to avoid rapid
            reconnect storms that waste energy.

    config DSP_PROVIDER_ID
        string "Provider participant identifier (IRI)"
        default "urn:uuid:dsp-embedded-provider-1"
        help
            The IRI used as the provider's participant identifier in DSP
            negotiation and transfer messages (dspace:providerId field).
            Should match the identifier registered with any connected DAPS.

    config DSP_CATALOG_DATASET_ID
        string "Static catalog dataset IRI"
        default "urn:uuid:dsp-embedded-sensor-dataset-1"
        help
            The @id IRI used for the single dataset entry in the static
            dcat:Catalog response served at GET /catalog.  This is the
            identifier counterparts use to reference the dataset in
            contract negotiations and transfer requests.

    config DSP_CATALOG_TITLE
        string "Static catalog title"
        default "DSP Embedded Sensor Catalog"
        help
            The dct:title string of the catalog returned at GET /catalog.

    config DSP_LOG_LEVEL_VERBOSE
        bool "Enable verbose DSP protocol logging"
        default n
        help
            Logs full request/response bodies and state machine transitions.
            Useful during development and integration testing. Disable in
            production to reduce flash usage and serial I/O overhead.

endmenu
```

## components/dsp_dht20/Kconfig
```kconfig
menu "DHT20 Sensor (dsp_dht20)"

    config DSP_DHT20_SDA_PIN
        int "DHT20 I2C SDA GPIO number"
        default 8
        range 0 48
        help
            GPIO number for the I2C SDA line of the DHT20 sensor.
            Requires an external 4.7 kΩ pull-up resistor to 3.3 V.
            Default GPIO 8 is available on most ESP32-S3 development boards.

    config DSP_DHT20_SCL_PIN
        int "DHT20 I2C SCL GPIO number"
        default 9
        range 0 48
        help
            GPIO number for the I2C SCL line of the DHT20 sensor.
            Requires an external 4.7 kΩ pull-up resistor to 3.3 V.
            Default GPIO 9 is available on most ESP32-S3 development boards.

    config DSP_DHT20_I2C_PORT
        int "I2C peripheral port number (0 or 1)"
        default 0
        range 0 1
        help
            ESP32-S3 I2C peripheral index.  Use 0 unless port 0 is already
            occupied by another component.

endmenu
```

## main/Kconfig.projbuild
```kconfig
menu "DSP Embedded – One-shot WiFi Provisioning"

    config DSP_WIFI_PROVISION
        bool "Write WiFi credentials to NVS on next boot"
        default n
        help
            When enabled, app_main() calls dsp_wifi_store_credentials() with
            the SSID and password below, writes them to NVS, then continues
            to connect normally.  Disable this option after the first
            successful boot to avoid re-writing NVS on every reset.

            Build with:
              idf.py -DSDKCONFIG_DEFAULTS="sdkconfig.defaults;sdkconfig.wifi"
            where sdkconfig.wifi contains:
              CONFIG_DSP_WIFI_PROVISION=y
              CONFIG_DSP_WIFI_PROVISION_SSID="YourSSID"
              CONFIG_DSP_WIFI_PROVISION_PASSWORD="YourPassword"

    config DSP_WIFI_PROVISION_SSID
        string "WiFi SSID"
        default ""
        depends on DSP_WIFI_PROVISION
        help
            Network SSID to write to NVS.

    config DSP_WIFI_PROVISION_PASSWORD
        string "WiFi password"
        default ""
        depends on DSP_WIFI_PROVISION
        help
            WPA2 passphrase to write to NVS.

endmenu
```

## sdkconfig.defaults
```kconfig
# DSP Embedded – sdkconfig defaults for ESP32-S3
# Apply with: idf.py -DSDKCONFIG_DEFAULTS=sdkconfig.defaults reconfigure

# Target
CONFIG_IDF_TARGET="esp32s3"

# Partition table
CONFIG_PARTITION_TABLE_CUSTOM=y
CONFIG_PARTITION_TABLE_CUSTOM_FILENAME="partitions.csv"

# Flash
CONFIG_ESPTOOLPY_FLASHSIZE_4MB=y
CONFIG_ESPTOOLPY_FLASHSIZE="4MB"
CONFIG_ESPTOOLPY_FLASHFREQ_80M=y
CONFIG_ESPTOOLPY_FLASHMODE_QIO=y

# CPU frequency
CONFIG_ESP_DEFAULT_CPU_FREQ_MHZ_240=y

# PSRAM – disabled by default, enable via CONFIG_DSP_PSRAM_ENABLE
CONFIG_SPIRAM=n

# FreeRTOS
CONFIG_FREERTOS_HZ=1000
CONFIG_FREERTOS_UNICORE=n

# Logging
CONFIG_LOG_DEFAULT_LEVEL_INFO=y

# Stack sizes
CONFIG_ESP_MAIN_TASK_STACK_SIZE=8192

# NVS encryption – off by default (key provisioned separately)
CONFIG_NVS_ENCRYPTION=n

# =============================================================================
# mbedTLS – DSP-101 optimised configuration
# See components/dsp_mbedtls/include/mbedtls_config_dsp.h for full rationale.
# Target: ≤50 KB heap at peak TLS handshake.
# =============================================================================

# --- TLS role: server-only (provider node, no outgoing TLS in initial scope) ---
CONFIG_MBEDTLS_TLS_SERVER_ONLY=y

# --- Protocol versions: TLS 1.2 + TLS 1.3 ---
CONFIG_MBEDTLS_SSL_PROTO_TLS1_2=y
CONFIG_MBEDTLS_SSL_PROTO_TLS1_3=y
CONFIG_MBEDTLS_SSL_TLS1_3_COMPATIBILITY_MODE=y
CONFIG_MBEDTLS_SSL_PROTO_DTLS=n

# --- Key exchange: ECDHE only (forward secrecy) ---
CONFIG_MBEDTLS_KEY_EXCHANGE_ELLIPTIC_CURVE=y
CONFIG_MBEDTLS_KEY_EXCHANGE_ECDHE_RSA=y
CONFIG_MBEDTLS_KEY_EXCHANGE_ECDHE_ECDSA=y
CONFIG_MBEDTLS_KEY_EXCHANGE_ECDH_ECDSA=n
CONFIG_MBEDTLS_KEY_EXCHANGE_ECDH_RSA=n
CONFIG_MBEDTLS_KEY_EXCHANGE_RSA=n
CONFIG_MBEDTLS_KEY_EXCHANGE_DHE_RSA=n
CONFIG_MBEDTLS_PSK_MODES=y
CONFIG_MBEDTLS_KEY_EXCHANGE_PSK=y
CONFIG_MBEDTLS_KEY_EXCHANGE_DHE_PSK=n
CONFIG_MBEDTLS_KEY_EXCHANGE_ECDHE_PSK=n
CONFIG_MBEDTLS_KEY_EXCHANGE_RSA_PSK=n
CONFIG_MBEDTLS_KEY_EXCHANGE_ECJPAKE=n

# --- Hardware acceleration (ESP32-S3) ---
CONFIG_MBEDTLS_HARDWARE_AES=y
CONFIG_MBEDTLS_HARDWARE_GCM=y
CONFIG_MBEDTLS_HARDWARE_MPI=y
CONFIG_MBEDTLS_HARDWARE_SHA=y
CONFIG_MBEDTLS_HARDWARE_ECC=y
CONFIG_MBEDTLS_HARDWARE_ECDSA_SIGN=y
CONFIG_MBEDTLS_HARDWARE_ECDSA_VERIFY=y

# --- Symmetric ciphers ---
CONFIG_MBEDTLS_AES_C=y
CONFIG_MBEDTLS_GCM_C=y
CONFIG_MBEDTLS_CAMELLIA_C=n
CONFIG_MBEDTLS_DES_C=n
CONFIG_MBEDTLS_BLOWFISH_C=n
CONFIG_MBEDTLS_XTEA_C=n
CONFIG_MBEDTLS_CCM_C=n
CONFIG_MBEDTLS_NIST_KW_C=n
CONFIG_MBEDTLS_CHACHA20_C=n
CONFIG_MBEDTLS_POLY1305_C=n
CONFIG_MBEDTLS_CHACHAPOLY_C=n

# --- Hash / MAC ---
CONFIG_MBEDTLS_SHA1_C=y
CONFIG_MBEDTLS_SHA512_C=n
CONFIG_MBEDTLS_SHA3_C=n
CONFIG_MBEDTLS_RIPEMD160_C=n
CONFIG_MBEDTLS_CMAC_C=n
CONFIG_MBEDTLS_HKDF_C=y

# --- Asymmetric / ECC ---
CONFIG_MBEDTLS_ECP_C=y
CONFIG_MBEDTLS_ECDH_C=y
CONFIG_MBEDTLS_ECDSA_C=y
CONFIG_MBEDTLS_ECDSA_DETERMINISTIC=y
CONFIG_MBEDTLS_DHM_C=n
CONFIG_MBEDTLS_ECJPAKE_C=n

# --- Elliptic curves: keep P-256, P-384, X25519; disable the rest ---
CONFIG_MBEDTLS_ECP_DP_SECP256R1_ENABLED=y
CONFIG_MBEDTLS_ECP_DP_SECP384R1_ENABLED=y
CONFIG_MBEDTLS_ECP_DP_CURVE25519_ENABLED=y
CONFIG_MBEDTLS_ECP_DP_SECP192R1_ENABLED=n
CONFIG_MBEDTLS_ECP_DP_SECP224R1_ENABLED=n
CONFIG_MBEDTLS_ECP_DP_SECP521R1_ENABLED=n
CONFIG_MBEDTLS_ECP_DP_SECP192K1_ENABLED=n
CONFIG_MBEDTLS_ECP_DP_SECP224K1_ENABLED=n
CONFIG_MBEDTLS_ECP_DP_SECP256K1_ENABLED=n
CONFIG_MBEDTLS_ECP_DP_BP256R1_ENABLED=n
CONFIG_MBEDTLS_ECP_DP_BP384R1_ENABLED=n
CONFIG_MBEDTLS_ECP_DP_BP512R1_ENABLED=n

# --- X.509 / PEM ---
CONFIG_MBEDTLS_PEM_PARSE_C=y
CONFIG_MBEDTLS_PEM_WRITE_C=n
CONFIG_MBEDTLS_X509_CRL_PARSE_C=n
CONFIG_MBEDTLS_X509_CSR_PARSE_C=n

# --- Certificate bundle: disabled (pre-provisioned device certs used) ---
CONFIG_MBEDTLS_CERTIFICATE_BUNDLE=n

# --- TLS features ---
CONFIG_MBEDTLS_SSL_ALPN=y
CONFIG_MBEDTLS_SERVER_SSL_SESSION_TICKETS=y
CONFIG_MBEDTLS_CLIENT_SSL_SESSION_TICKETS=y
CONFIG_MBEDTLS_SSL_RENEGOTIATION=n
CONFIG_MBEDTLS_SSL_KEEP_PEER_CERTIFICATE=n
CONFIG_MBEDTLS_ECP_RESTARTABLE=n

# --- I/O buffer sizes: 4 KB each (default 16 KB) ---
CONFIG_MBEDTLS_ASYMMETRIC_CONTENT_LEN=y
CONFIG_MBEDTLS_SSL_IN_CONTENT_LEN=4096
CONFIG_MBEDTLS_SSL_OUT_CONTENT_LEN=4096

# --- Dynamic buffer allocation: free I/O buffers when idle ---
CONFIG_MBEDTLS_DYNAMIC_BUFFER=y
CONFIG_MBEDTLS_DYNAMIC_FREE_CONFIG_DATA=y
CONFIG_MBEDTLS_DYNAMIC_FREE_CA_CERT=y

# --- Error strings: disabled in production (decode offline) ---
CONFIG_MBEDTLS_ERROR_STRINGS=n

# Watchdog
CONFIG_ESP_TASK_WDT_EN=y
CONFIG_ESP_TASK_WDT_TIMEOUT_S=30

# DSP feature flags
CONFIG_DSP_ENABLE_PSK=y

# WiFi one-shot provisioning – disabled by default
# To provision, create sdkconfig.wifi (gitignored) with:
#   CONFIG_DSP_WIFI_PROVISION=y
#   CONFIG_DSP_WIFI_PROVISION_SSID="YourSSID"
#   CONFIG_DSP_WIFI_PROVISION_PASSWORD="YourPassword"
# Then build with: idf.py -DSDKCONFIG_DEFAULTS="sdkconfig.defaults;sdkconfig.wifi" build flash
CONFIG_DSP_WIFI_PROVISION=n
```
